/*This dtsi file was generated by athena.xlsm Revision: 1.06 */
/*
 * Copyright (c) 2017, NVIDIA CORPORATION.  All rights reserved.
 *
 * This program is free software; you can redistribute it and/or modify
 * it under the terms of the GNU General Public License as published by
 * the Free Software Foundation; either version 2 of the License, or
 * (at your option) any later version.
 *
 * This program is distributed in the hope that it will be useful, but WITHOUT
 * ANY WARRANTY; without even the implied warranty of MERCHANTABILITY or
 * FITNESS FOR A PARTICULAR PURPOSE.  See the GNU General Public License for
 * more details.
 */

#include <dt-bindings/gpio/tegra-gpio.h>

/ {
	gpio@2200000 {
		gpio-init-names = "default";
		gpio-init-0 = <&gpio_default>;

		gpio_default: default {
			gpio-input = <
				TEGRA_GPIO(S, 7)
				TEGRA_GPIO(G, 0)
				TEGRA_GPIO(G, 4)
				TEGRA_GPIO(G, 7)
				TEGRA_GPIO(H, 3)
				TEGRA_GPIO(H, 5)
				TEGRA_GPIO(Y, 0)
				TEGRA_GPIO(Y, 1)
				TEGRA_GPIO(Y, 2)
				TEGRA_GPIO(Y, 3)
				TEGRA_GPIO(Y, 4)
				TEGRA_GPIO(Y, 5)
				TEGRA_GPIO(Y, 7)
				TEGRA_GPIO(Z, 1)
				TEGRA_GPIO(Z, 3)
				TEGRA_GPIO(Z, 4)
				TEGRA_GPIO(Z, 5)
				TEGRA_GPIO(Z, 6)
				TEGRA_GPIO(Z, 7)
				TEGRA_GPIO(EE, 0)
				TEGRA_GPIO(EE, 4)
				TEGRA_GPIO(CC, 4)
				TEGRA_GPIO(Q, 1)
				TEGRA_GPIO(Q, 3)
				TEGRA_GPIO(Q, 6)
				TEGRA_GPIO(L, 2)
				TEGRA_GPIO(N, 1)
				>;
			gpio-output-low = <
				TEGRA_GPIO(G, 2)
				TEGRA_GPIO(X, 0)
				TEGRA_GPIO(AA, 5)
				TEGRA_GPIO(CC, 0)
				TEGRA_GPIO(CC, 2)
				TEGRA_GPIO(P, 4)
				TEGRA_GPIO(P, 5)
				TEGRA_GPIO(B, 0)
				>;
			gpio-output-high = <
				TEGRA_GPIO(CC, 1)
				>;
		};
	};
};
