/*
 * Copyright (c) 2021-2022, NVIDIA CORPORATION.  All rights reserved.
 *
 * This program is free software; you can redistribute it and/or modify
 * it under the terms of the GNU General Public License as published by
 * the Free Software Foundation; either version 2 of the License, or
 * (at your option) any later version.
 *
 * This program is distributed in the hope that it will be useful, but WITHOUT
 * ANY WARRANTY; without even the implied warranty of MERCHANTABILITY or
 * FITNESS FOR A PARTICULAR PURPOSE.  See the GNU General Public License for
 * more details.
 */
/*
# CFG Version 1.0
# This File contains the configuration of multiple rails.
*/
/dts-v1/;

/ {
/* Placeholder currently. Data must be populated once available */
    prod {
        major = <1>;
        minor = <0>;
        addr-mask-data =     <0x02430014 0x0001f000 0x0001f000>,
			     <0x0243001C 0x0001f000 0x0001f000>,
			     <0x0243003C 0x0001f000 0x0001f000>,
			     <0x02430044 0x0001f000 0x0001f000>,
			     <0x0243402C 0x0001f000 0x0001f000>,
			     <0x02434034 0x0001f000 0x0001f000>,
			     <0x02440054 0x0001f000 0x0001f000>,
			     <0x0244005C 0x0001f000 0x0001f000>,
			     <0x02440064 0x0001f000 0x0001f000>,
			     <0x0244006C 0x0001f000 0x0001f000>,
			     <0x02440074 0x0001f000 0x0001f000>,
			     <0x0244007C 0x0001f000 0x0001f000>,
			     <0x0C30201C 0x0001f000 0x0001f000>,
			     <0x0C302024 0x0001f000 0x0001f000>,
			     <0x0C302034 0x0001f000 0x0001f000>,
			     <0x0C302044 0x0001f000 0x0001f000>,
			     /* I2S1 */
			     <0x02448000 0x00001000 0x00001000>,
			     <0x02448010 0x00001000 0x00001000>,
			     <0x02448018 0x00001000 0x00001000>,
			     <0x02448004 0x01f1f000 0x01f1f000>,
			     <0x0244800C 0x01f1f000 0x01f1f000>,
			     <0x02448014 0x01f1f000 0x01f1f000>,
			     <0x0244801C 0x01f1f000 0x01f1f000>,
			     /* I2S2 */
			     <0x02434088 0x00001000 0x00001000>,
			     <0x02434098 0x00001000 0x00001000>,
			     <0x024340a0 0x00001000 0x00001000>,
			     <0x0243408C 0x01f1f000 0x01f1f000>,
			     <0x02434094 0x01f1f000 0x01f1f000>,
			     <0x0243409C 0x01f1f000 0x01f1f000>,
			     <0x024340A4 0x01f1f000 0x01f1f000>,
			     /* I2S4 */
			     <0x02432000 0x00001000 0x00001000>,
			     <0x02432010 0x00001000 0x00001000>,
			     <0x02432018 0x00001000 0x00001000>,
			     <0x02432004 0x01f1f000 0x01f1f000>,
			     <0x0243200C 0x01f1f000 0x01f1f000>,
			     <0x02432014 0x01f1f000 0x01f1f000>,
			     <0x0243201C 0x01f1f000 0x01f1f000>,
			     /* DMIC3 */
			     <0x0C303048 0x00001000 0x00001000>,
			     <0x0C303044 0xf0000000 0xf0000000>,
			     <0x0C30304C 0xf0000000 0xf0000000>,
			     /* AUD_MCLK */
			     <0x02448034 0x01f1f000 0x01f1f000>,
			     /* NV_THERM_FAN_TACH0 */
			     <0x02430050 0x00001000 0x00001000>;
    };
};

